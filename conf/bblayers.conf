## conf/bblayers.conf
```bitbake
# POKY_BBLAYERS_CONF_VERSION is increased each time build/conf/bblayers.conf
# changes incompatibly
POKY_BBLAYERS_CONF_VERSION = "2"

BBPATH = "${TOPDIR}"
BBFILES ?= ""

BBLAYERS ?= " \
  /home/unknown/yocto/poky/meta \
  /home/unknown/yocto/poky/meta-poky \
  /home/unknown/yocto/poky/meta-yocto-bsp \
  /home/unknown/yocto/poky/build/mylayer \
  "
```
